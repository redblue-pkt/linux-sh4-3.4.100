## Documentation/devicetree/bindings/stm/soc.txt
```
===============================================================================
			stm socs
===============================================================================

Optional properties:
	power-on-gpio	: Board specific power-on pios.
	id		: Should be a sysconf where chip  id can be read from.
	reset		: should be a sysconf or soc specific information to reset it.
	reset_mask	: should be a sysconf or soc specific information to un-mask the reset bit
Example:
	soc{
		id		= <&stih415_sysconf 427 0 31>;
		reset		= <&stih415_sysconf 11 0 0>;
		...
		...
	};
```

## arch/arm/configs/b2148_defconfig
```kconfig
CONFIG_EXPERIMENTAL=y
CONFIG_LOCALVERSION="-b2120"
# CONFIG_LOCALVERSION_AUTO is not set
CONFIG_SYSVIPC=y
CONFIG_POSIX_MQUEUE=y
CONFIG_BSD_PROCESS_ACCT=y
CONFIG_TASKSTATS=y
CONFIG_TASK_DELAY_ACCT=y
CONFIG_TASK_XACCT=y
CONFIG_TASK_IO_ACCOUNTING=y
CONFIG_AUDIT=y
CONFIG_IKCONFIG=y
CONFIG_IKCONFIG_PROC=y
CONFIG_CGROUPS=y
CONFIG_CGROUP_FREEZER=y
CONFIG_CGROUP_DEVICE=y
CONFIG_CPUSETS=y
CONFIG_CGROUP_CPUACCT=y
CONFIG_RESOURCE_COUNTERS=y
CONFIG_CGROUP_MEM_RES_CTLR=y
CONFIG_CGROUP_MEM_RES_CTLR_SWAP=y
CONFIG_NAMESPACES=y
CONFIG_CC_OPTIMIZE_FOR_SIZE=y
CONFIG_SYSCTL_SYSCALL=y
CONFIG_KALLSYMS_ALL=y
CONFIG_EMBEDDED=y
# CONFIG_COMPAT_BRK is not set
CONFIG_MODULES=y
CONFIG_MODULE_UNLOAD=y
CONFIG_MODULE_SRCVERSION_ALL=y
CONFIG_BLK_DEV_INTEGRITY=y
CONFIG_ARCH_STM=y
CONFIG_MACH_STM_STIH407_BOARD=y
CONFIG_MACH_STM_STIH407_FIXED_1000_SPEED=y
# CONFIG_SWP_EMULATE is not set
CONFIG_ARM_ERRATA_743622=y
CONFIG_ARM_ERRATA_751472=y
CONFIG_ARM_ERRATA_754322=y
CONFIG_ARM_ERRATA_775420=y
CONFIG_PCI=y
CONFIG_SMP=y
CONFIG_VMSPLIT_2G=y
CONFIG_PREEMPT=y
CONFIG_AEABI=y
CONFIG_KSM=y
CONFIG_USE_OF=y
CONFIG_VFP=y
CONFIG_NEON=y
# CONFIG_CORE_DUMP_DEFAULT_ELF_HEADERS is not set
CONFIG_HIBERNATION_ON_MEMORY=y
CONFIG_PM_RUNTIME=y
CONFIG_NET=y
CONFIG_PACKET=y
CONFIG_UNIX=y
CONFIG_INET=y
CONFIG_IP_PNP=y
CONFIG_IP_PNP_DHCP=y
CONFIG_SYN_COOKIES=y
CONFIG_IPV6=y
CONFIG_INET6_XFRM_MODE_TRANSPORT=m
CONFIG_INET6_XFRM_MODE_TUNNEL=m
CONFIG_INET6_XFRM_MODE_BEET=m
CONFIG_IPV6_SIT=m
CONFIG_NETFILTER=y
# CONFIG_STANDALONE is not set
# CONFIG_PREVENT_FIRMWARE_BUILD is not set
# CONFIG_FIRMWARE_IN_KERNEL is not set
CONFIG_DEBUG_DEVRES=y
CONFIG_CONNECTOR=y
CONFIG_MTD=y
CONFIG_MTD_STM_SPI_FSM=y
CONFIG_BLK_DEV_LOOP=y
CONFIG_BLK_DEV_RAM=y
CONFIG_BLK_DEV_RAM_SIZE=16384
CONFIG_BLK_DEV_SD=y
CONFIG_ATA=y
CONFIG_SATA_AHCI=y
CONFIG_SATA_AHCI_PLATFORM=y
# CONFIG_ATA_SFF is not set
CONFIG_NETDEVICES=y
CONFIG_NWHW_CONFIG=y
CONFIG_STMMAC_ETH=y
CONFIG_VIA_RHINE=m
CONFIG_VIA_RHINE_MMIO=y
CONFIG_VIA_VELOCITY=y
CONFIG_RTL8366_SMI=y
CONFIG_RTL8366_SMI_DEBUG_FS=y
CONFIG_RTL8367_PHY=y
CONFIG_USB_USBNET=y
# CONFIG_INPUT_MOUSEDEV is not set
CONFIG_INPUT_EVDEV=y
# CONFIG_INPUT_KEYBOARD is not set
# CONFIG_INPUT_MOUSE is not set
CONFIG_INPUT_MISC=y
CONFIG_INPUT_TM1668=y
# CONFIG_SERIO is not set
CONFIG_VT_HW_CONSOLE_BINDING=y
# CONFIG_LEGACY_PTYS is not set
# CONFIG_DEVKMEM is not set
CONFIG_HW_RANDOM=y
CONFIG_I2C=y
CONFIG_I2C_CHARDEV=y
CONFIG_I2C_STM=y
CONFIG_SPI=y
CONFIG_SPI_DEBUG=y
CONFIG_SPI_GPIO=y
CONFIG_SPI_STM=y
CONFIG_GPIO_SYSFS=y
CONFIG_SENSORS_STM_PWM=y
CONFIG_SENSORS_STM_TEMP=y
CONFIG_SSB=m
CONFIG_MFD_SM501=m
CONFIG_MFD_SM501_GPIO=y
CONFIG_MEDIA_SUPPORT=y
CONFIG_MEDIA_CONTROLLER=y
CONFIG_VIDEO_DEV=y
CONFIG_VIDEO_V4L2_SUBDEV_API=y
CONFIG_DVB_CORE=y
CONFIG_LIRC_STM=y
CONFIG_DVB_DYNAMIC_MINORS=y
CONFIG_FB=y
CONFIG_FB_SOFTWARE_DRAWING_HELPERS=y
CONFIG_SOUND=y
CONFIG_SND=y
# CONFIG_SND_SUPPORT_OLD_API is not set
# CONFIG_SND_DRIVERS is not set
# CONFIG_SND_PCI is not set
# CONFIG_SND_ARM is not set
# CONFIG_SND_SPI is not set
# CONFIG_SND_USB is not set
CONFIG_SND_STM=y
CONFIG_USB=y
CONFIG_USB_DWC3=y
CONFIG_USB_DWC3_HOST=y
# CONFIG_USB_DWC3_EXYNOS is not set
# CONFIG_USB_DWC3_PCI is not set
CONFIG_USB_XHCI_HCD=y
CONFIG_USB_STORAGE=y
CONFIG_USB_GADGET=y
CONFIG_MMC=y
CONFIG_MMC_SDHCI=y
CONFIG_MMC_SDHCI_PLTFM=y
CONFIG_MMC_SDHCI_STM=y
CONFIG_NEW_LEDS=y
CONFIG_LEDS_CLASS=y
CONFIG_LEDS_TRIGGERS=y
CONFIG_LEDS_TRIGGER_HEARTBEAT=y
# CONFIG_STM_FDMA_MCHI is not set
# CONFIG_STM_FDMA_TELSS is not set
# CONFIG_IOMMU_SUPPORT is not set
CONFIG_STM_PCIE=y
# CONFIG_STM_RNG is not set
CONFIG_MALI400=y
CONFIG_EXT2_FS=y
CONFIG_EXT3_FS=y
# CONFIG_EXT3_DEFAULTS_TO_ORDERED is not set
CONFIG_XFS_FS=y
# CONFIG_DNOTIFY is not set
CONFIG_TMPFS=y
CONFIG_TMPFS_POSIX_ACL=y
CONFIG_NFS_FS=y
CONFIG_NFS_V3=y
CONFIG_ROOT_NFS=y
CONFIG_PRINTK_TIME=y
CONFIG_FRAME_WARN=2048
CONFIG_MAGIC_SYSRQ=y
CONFIG_UNUSED_SYMBOLS=y
# CONFIG_SCHED_DEBUG is not set
# CONFIG_DEBUG_PREEMPT is not set
CONFIG_DEBUG_INFO=y
# CONFIG_FTRACE is not set
CONFIG_DEBUG_LL=y
CONFIG_EARLY_PRINTK=y
CONFIG_SECURITYFS=y
CONFIG_CRYPTO_MANAGER=y
CONFIG_CRYPTO_SEQIV=y
CONFIG_CRYPTO_CRC32C=y
# CONFIG_CRYPTO_ANSI_CPRNG is not set
# CONFIG_CRYPTO_HW is not set
```

## arch/arm/mach-stm/Kconfig
```kconfig
menu "STMicroelectronics Consumer Electronics platform type"
	depends on ARCH_STM

# CPU_SUBTYPE_xxx style names for code shared with SH4

config CPU_SUBTYPE_STIH415
       def_bool n

config CPU_SUBTYPE_STIH416
       def_bool n

config MACH_STM_STID127
	def_bool n
	select STM_IRQ_MUX
	help
	  Include support for a generic STiD127 (Alicante) platform.

config MACH_STM_STID127_BOARD
	bool "Generic board support for StiD127 based boards via Device trees"
	depends on OF
	select MACH_STM_STID127
	select FIXED_PHY
	help
	Include support for a Generic Board based on device trees for StiD127

config MACH_STM_STIH407
	def_bool n
	select STM_HAS_MALI
	help
	  Include support for a generic STiH407 (Monaco) platform.

config MACH_STM_STIH407_BOARD
	bool "Generic board support for STiH407 based boards via Device trees"
	depends on OF
	select MACH_STM_STIH407
	select FIXED_PHY
	help
	  Include support for a Generic Board based on device trees for
	  StiH07 (Monaco/Cannes)

config MACH_STM_STIH407_FIXED_1000_SPEED
	bool "Force link speed to 1000"
	depends on MACH_STM_STIH407_BOARD
	help
	  This is to use on the b2089 and b2120 boards the network and the
	  embedded switch to use 1000 speed instead of 100 (default).
	  A change is also required in the board dtsp file to set the extif speed
	  to <2> for GiGa

		realtek: rtl8367rb {
		...
			rtl8367rb,extif2-speed = <2>;
		};

config MACH_STM_STIH415
	def_bool n
	select CPU_SUBTYPE_STIH415
	select ARCH_HAS_CPUFREQ
	select STM_HAS_MALI
	help
	  Include support for a generic STiH415 (Orly) platform.

config MACH_STM_STIH415_BOARD
	bool "Generic board support for STiH415 based boards via Device trees"
	depends on OF
	select MACH_STM_STIH415
	help
	Include support for a Generic Board based on device trees for
	StiH415 (Orly-1)

config MACH_STM_STIH416
	def_bool n
	select ARCH_HAS_CPUFREQ
	select CPU_SUBTYPE_STIH416
	select STM_HAS_MALI
	help
	 Include support for a generic STiH416 (Orly-2) platform.

config MACH_STM_STIH416_BOARD
	bool "Generic board support for STiH416 based boards via Device trees"
	depends on OF
	select MACH_STM_STIH416
	help
	Include support for a Generic Board based on device trees for
	StiH416 (Orly-2)

config MACH_STM_B2000
	bool "Support B2000 - STiH415/STiH416 (Orly/Orly-2) MBoard"
	help
	  Include support for a B2000 - STiH415/STiH416 (Orly/Orly-2) MBoard.

# b2000 specific configuration
source "arch/arm/mach-stm/Kconfig.b2000"

config MACH_STM_B2020
	bool "Support B2020 - STiH415/STiH416 (Orly-1/Orly-2) ADI Board"
	help
	  Include support for a B2020 - STiH415/STiH416 (Orly-1/Orly-2) ADI Board.

# b2020 specific configuration
source "arch/arm/mach-stm/Kconfig.b2020"

config MACH_STM_B2092
	bool "Support B2092 - STiH416 (Orly-2) MBoard"
	select MACH_STM_STIH416
	help
	  Include support for a B2092 - STiH416 (Orly-2) MBoard.

# b2092 specific configuration
source "arch/arm/mach-stm/Kconfig.b2092"

config MACH_STM_B2105
	bool "Support B2105 - STiH416 (Orly-2) Zaragoza Premium board"
	select MACH_STM_STIH416
	select FIXED_PHY
	help
	  Include support for a B2105 - STiH416 (Orly-2) Zaragoza Premium board.

config MACH_STM_B2116
	bool "Support B2116 - STiH315 ADI board"
	select MACH_STM_STIH416
	help
	  Include support for a B2116 - STiH315 ADI board.

config MACH_STM_B2147
	bool "Support B2147 - STiD127 (Alicante) Board"
	depends on OF
	select MACH_STM_STID127_BOARD
	help
	  Include support for B2147 Alicante Data Gateway board

config STM_CPU_FREQ
	def_bool CPU_FREQ
	select CPU_FREQ_TABLE

endmenu
```

## arch/sh/configs/b2108_defconfig
```kconfig
CONFIG_EXPERIMENTAL=y
CONFIG_LOCALVERSION="-b2108"
# CONFIG_LOCALVERSION_AUTO is not set
CONFIG_SYSVIPC=y
CONFIG_IKCONFIG=y
CONFIG_IKCONFIG_PROC=y
CONFIG_LOG_BUF_SHIFT=14
CONFIG_BLK_DEV_INITRD=y
CONFIG_SYSCTL_SYSCALL=y
CONFIG_KALLSYMS_ALL=y
CONFIG_EMBEDDED=y
CONFIG_SLAB=y
CONFIG_MODULES=y
CONFIG_MODULE_UNLOAD=y
CONFIG_MODULE_FORCE_UNLOAD=y
# CONFIG_BLK_DEV_BSG is not set
CONFIG_CPU_SUBTYPE_STXH205=y
CONFIG_MEMORY_START=0x40000000
CONFIG_MEMORY_SIZE=0x7C00000
CONFIG_PMB=y
CONFIG_PMB_LARGE_UNCACHED_MAPPING=y
# CONFIG_VSYSCALL is not set
CONFIG_FLATMEM_MANUAL=y
CONFIG_BPA2=y
CONFIG_STM_L2_CACHE=y
CONFIG_SH_ST_B2108=y
CONFIG_GENERIC_CALIBRATE_DELAY=y
CONFIG_HEARTBEAT=y
CONFIG_HZ_1000=y
CONFIG_PREEMPT=y
CONFIG_CC_STACKPROTECTOR=y
CONFIG_ZERO_PAGE_OFFSET=0x800000
# CONFIG_CORE_DUMP_DEFAULT_ELF_HEADERS is not set
CONFIG_HIBERNATION_ON_MEMORY=y
CONFIG_PM_RUNTIME=y
CONFIG_NET=y
CONFIG_PACKET=y
CONFIG_UNIX=y
CONFIG_INET=y
CONFIG_IP_MULTICAST=y
CONFIG_IP_PNP=y
CONFIG_IPV6=y
CONFIG_NETFILTER=y
CONFIG_CFG80211=y
CONFIG_WIRELESS_EXT_SYSFS=y
CONFIG_MAC80211=y
CONFIG_UEVENT_HELPER_PATH="/sbin/hotplug"
CONFIG_MTD=y
CONFIG_MTD_CMDLINE_PARTS=y
CONFIG_MTD_CHAR=y
CONFIG_MTD_BLOCK=y
CONFIG_MTD_CFI=y
CONFIG_MTD_CFI_INTELEXT=y
CONFIG_MTD_CFI_AMDSTD=y
CONFIG_MTD_CFI_STAA=y
CONFIG_MTD_PHYSMAP=y
CONFIG_MTD_NAND=y
CONFIG_MTD_NAND_PLATFORM=y
CONFIG_MTD_NAND_STM_BCH=y
CONFIG_STM_NAND_BCH_DEBUG=y
CONFIG_MTD_UBI=y
CONFIG_MTD_UBI_GLUEBI=y
CONFIG_BLK_DEV_RAM=y
CONFIG_BLK_DEV_SD=y
CONFIG_BLK_DEV_SR=y
CONFIG_CHR_DEV_SG=y
CONFIG_ATA=y
# CONFIG_SATA_PMP is not set
CONFIG_NETDEVICES=y
CONFIG_NWHW_CONFIG=y
CONFIG_USB_USBNET=y
# CONFIG_USB_NET_CDC_SUBSET is not set
CONFIG_USB_ZD1201=y
CONFIG_HOSTAP=y
CONFIG_LIBERTAS=y
CONFIG_LIBERTAS_USB=y
CONFIG_INPUT_EVDEV=y
# CONFIG_KEYBOARD_ATKBD is not set
# CONFIG_MOUSE_PS2 is not set
# CONFIG_LEGACY_PTYS is not set
CONFIG_HW_RANDOM=y
CONFIG_I2C=y
CONFIG_I2C_CHARDEV=y
CONFIG_I2C_STM=y
CONFIG_I2C_STM_GLITCH_SUPPORT=y
CONFIG_DEBUG_GPIO=y
CONFIG_SENSORS_STM_TEMP=y
CONFIG_VIDEO_OUTPUT_CONTROL=y
CONFIG_FB=y
CONFIG_FB_SOFTWARE_DRAWING_HELPERS=y
CONFIG_FB_MODE_HELPERS=y
CONFIG_FB_TILEBLITTING=y
CONFIG_USB=y
CONFIG_USB_DEVICEFS=y
CONFIG_USB_MON=y
CONFIG_USB_EHCI_HCD=y
# CONFIG_USB_EHCI_TT_NEWSCHED is not set
CONFIG_USB_OHCI_HCD=y
CONFIG_USB_STORAGE=y
CONFIG_MMC=y
CONFIG_MMC_DEBUG=y
CONFIG_MMC_SDHCI=y
CONFIG_MMC_SDHCI_PLTFM=y
CONFIG_MMC_USHC=y
CONFIG_NEW_LEDS=y
CONFIG_LEDS_CLASS=y
# CONFIG_RTC_DRV_STM_LPC is not set
CONFIG_STPIO=y
CONFIG_STM_LPM=y
CONFIG_STM_LPM_DEBUG=y
CONFIG_EXT2_FS=y
CONFIG_EXT2_FS_XATTR=y
CONFIG_EXT3_FS=y
# CONFIG_EXT3_DEFAULTS_TO_ORDERED is not set
CONFIG_REISERFS_FS=y
CONFIG_JFS_FS=y
CONFIG_FUSE_FS=y
CONFIG_ISO9660_FS=y
CONFIG_JOLIET=y
CONFIG_UDF_FS=y
CONFIG_MSDOS_FS=y
CONFIG_VFAT_FS=y
CONFIG_NTFS_FS=y
CONFIG_PROC_KCORE=y
CONFIG_TMPFS=y
CONFIG_JFFS2_FS=y
CONFIG_UBIFS_FS=y
CONFIG_UBIFS_FS_XATTR=y
CONFIG_UBIFS_FS_ADVANCED_COMPR=y
CONFIG_CRAMFS=y
CONFIG_ROMFS_FS=y
CONFIG_NFS_FS=y
CONFIG_NFS_V3=y
CONFIG_ROOT_NFS=y
CONFIG_CIFS=y
CONFIG_NLS_CODEPAGE_437=y
CONFIG_NLS_ISO8859_1=y
# CONFIG_ENABLE_MUST_CHECK is not set
CONFIG_DEBUG_KERNEL=y
# CONFIG_SCHED_DEBUG is not set
CONFIG_DEBUG_KMEMLEAK=y
# CONFIG_DEBUG_BUGVERBOSE is not set
CONFIG_DEBUG_INFO=y
CONFIG_FRAME_POINTER=y
CONFIG_CRYPTO_CBC=m
CONFIG_CRYPTO_PCBC=m
CONFIG_LIBCRC32C=y
```
