## drivers/stm/Kconfig
```kconfig
#
# STM specific device configuration
#

config STM_DRIVERS
	def_bool n
	select ARCH_REQUIRE_GPIOLIB

menu "STM specific devices"
        depends on STM_DRIVERS

config STM_PCI_EMISS
	bool "STMicroelectronics PCI controller"
	depends on PCI && (CPU_SUBTYPE_STX7108)
	def_bool n
	---help---
	  This option adds support for the PCI controller found on some
	  STMicroelectronics SOCs.

# PCIe controller from synopsys, wrapped for HVD parts
config STM_PCIE
	bool "STMicroelectronics PCI express controller"
	depends on PCI && (CPU_SUBTYPE_STX7108 || CPU_SUBTYPE_STXH205 || \
		ARCH_STM)
	def_bool n
	select ARCH_SUPPORTS_MSI
	---help---
	  This option adds support for the PCI express controller found on some
	  STMicroelectronics SOCs.

config STM_MIPHY
	def_bool y

config STM_MIPHY_TAP
	bool
	depends on STM_MIPHY
	default y if CPU_SUBTYPE_STX7108
	default y if CPU_SUBTYPE_STIH415
	default n

config STM_MIPHY_PCIE_MP
	bool
	depends on STM_MIPHY
	default y if CPU_SUBTYPE_STX7108
	default y if MACH_STM_STID127
	default y if CPU_SUBTYPE_STXH205
	default y if CPU_SUBTYPE_STIH415
	default y if MACH_STM_STIH416
	default y if MACH_STM_STIH407
	default n

config STM_MIPHY_DUMMY
	bool
	depends on STM_MIPHY
	default n

config STM_MIPHY365X
	bool
	depends on STM_MIPHY
	default y if CPU_SUBTYPE_STX7108
	default y if CPU_SUBTYPE_STIH415
	default y if MACH_STM_STIH416
	default n

config STM_MIPHYA40X
	bool
	depends on STM_MIPHY
	default y if MACH_STM_STID127
	default y if CPU_SUBTYPE_STXH205
	default n

config STM_MIPHY28LP
	bool
	depends on STM_MIPHY
	default y if MACH_STM_STIH407

config STPIO
	bool "Legacy stpio API"
	default n
	help
	  Select this option to enable the legacy stpio interface. No
	  code within the kernel uses this API, it is retained only for
	  drivers outside the kernel which might still need it.

config STM_COPROCESSOR_CLASS
	tristate "STMicroelectronics coprocessor support"
	select FW_LOADER
	select BPA2
	select LIBELF_32
	---help---
	  Many of the ST system-on-chip devices have multiple CPUs, where a
	  master CPU running Linux has control over a number of slave CPUs,
	  which are usually used to run dedicated algorithms.
	  Enabling this option will add support to the Linux kernel to
	  control these slave CPUs, reserve memory for them, and thus allow
	  code to be downloaded onto them and executed.

	  Memory allocation is managed through BPA2 so, to define a
	  coprocessor's memory size and address, use the normal BPA2
	  command line option:
	    bpa2_parts=<name0>:<size0>:<address0>,<name1>:<size1>:<address1>,...
	  where:
	    <nameX> is "coproc_" followed by the coprocessor name, for example
	    "audio0".
	    <sizeX> defines the size of the partition
	    <addressX> defines the base address of memory reserved for the
	    coprocessor application code and data.

	  For example:
	    bpa2_parts=coproc_video0:16m:0x06000000,coproc_audio0:16m:0x07000000

	  As with all other BPA2 addresses, addresses are physical addresses,
	  and so may appear at different virtual addresses when mapped into the
	  CPU's memory map.

config STM_COPROCESSOR_ST40
	tristate "ST40 coprocessor support"
	depends on STM_COPROCESSOR_CLASS
	---help---
	  Provide support for ST40 coprocessor hardware.

config STM_COPROCESSOR_ST200
	tristate "ST200 coprocessor support"
	depends on STM_COPROCESSOR_CLASS
	---help---
	  Provide support for ST200 coprocessor hardware.

config  COPROCESSOR_DEBUG
        depends on STM_COPROCESSOR_CLASS
        bool "STM coprocessor debug"
        default n
        ---help---
          Enable this option to print out information about the slave CPUs
          addresses and operations you are using for coprocessor.

config STM_RNG
       bool "STM Random Number Generator Support"
       default y
       ---help---
         This option adds support for the hardware Random Number Generator
         (RNG) present on different STMicroelectronics SoCs.  It allows the
         RNG to feed /dev/random with entropy thereby ensuring real
         random numbers from this device.

         Without this option, /dev/random has little entropy and is not
         useful.  In fact, it may block for a long time while waiting for
         entropy.

         This option should always be enabled for relevant SoCs.

         This option can be used in conjunction with the /dev/hw_random
         driver found in the char drivers menu.

config STM_SYSTRACE
	bool "System Trace Module"
        depends on (STM_DRIVERS && ARCH_STM)
	select MTT
	default y
	---help---
	  The System Trace Module peripheral complies with MIPI-Alliance
	  specifications for the System Trace Protocol(STP) v2.
	  See http://www.mipi.org/specifications/debug and in Documentation
	  systrace.txt and mtt.txt.
	  The trace data is built and written through the MTT Trace facility
	  (see mtt-systrace.txt), and output on the MIPI wires.

config STM_AMBA_BRIDGE
	bool
        depends on STM_DRIVERS
	default y

config STM_IRQ_MUX
	depends on STM_DRIVERS
	bool "STM IRQ-Mux support"
	default n
	---help---
	  Enable this option to support IRQ-MUX mapping in the kernel.

config STM_LPM
	bool "STM Low Power Monitor"
	depends on CPU_SUBTYPE_STXH205
	select LIBELF_64
	default n
	help
	 Enable this option for Standby Controller support.

config STM_LPM_DEBUG
	bool "STM Low Power Monitor debug"
	depends on STM_LPM
	default n
	help
	 Enable this option to print debug information.

source "drivers/stm/mali/Kconfig"
endmenu
```

## drivers/stm/mali/Kconfig
```kconfig
config MALI400
	tristate "Mali-300/400/450 support"
	depends on ARM
	select DMA_SHARED_BUFFER
	---help---
	  This enables support for the ARM Mali-300, Mali-400, and Mali-450
	  GPUs.

	  To compile this driver as a module, choose M here: the module will be
	  called mali.

config MALI400_DEBUG
	bool "Enable debug in Mali driver"
	depends on MALI400
	---help---
	  This enabled extra debug checks and messages in the Mali driver.

config MALI400_PROFILING
	bool "Enable Mali profiling"
	depends on MALI400
	select TRACEPOINTS
	default n
	---help---
	  This enables gator profiling of Mali GPU events.

config MALI400_INTERNAL_PROFILING
	bool "Enable internal Mali profiling API"
	depends on MALI400_PROFILING
	default n
	---help---
	  This enables the internal legacy Mali profiling API.

config MALI400_POWER_PERFORMANCE_POLICY
	bool "Enable Mali power performance policy"
	depends on MALI400
	default n
	---help---
	  This enables support for dynamic performance scaling of Mali with the goal of lowering power consumption.

config MALI_DMA_BUF_MAP_ON_ATTACH
	bool "Map dma-buf attachments on attach"
	depends on MALI400 && DMA_SHARED_BUFFER
	default y
	---help---
	  This makes the Mali driver map dma-buf attachments after doing
	  attach. If this is not set the dma-buf attachments will be mapped for
	  every time the GPU need to access the buffer.

	  Mapping for each access can cause lower performance.

config MALI_SHARED_INTERRUPTS
	bool "Support for shared interrupts"
	depends on MALI400
	default n
	---help---
	  Adds functionality required to properly support shared interrupts.  Without this support,
	  the device driver will fail during insmod if it detects shared interrupts.  This also
	  works when the GPU is not using shared interrupts, but might have a slight performance
	  impact.

config MALI_PMU_PARALLEL_POWER_UP
	bool "Power up Mali PMU domains in parallel"
	depends on MALI400
	default n
	---help---
	  This makes the Mali driver power up all PMU power domains in parallel, instead of
	  powering up domains one by one, with a slight delay in between. Powering on all power
	  domains at the same time may cause peak currents higher than what some systems can handle.
	  These systems must not enable this option.

menu "STM Mali-400 configuration"
	depends on MALI400
	comment "Configurable Stm Mali-400 options"

config STM_MALI_MEM_SIZE
	hex "Max memory size for shared model"
	default "0x0E000000"
	---help---
	  Specify the size of memory which the Mali driver is allowed to
	  allocate from Linux kernel.
	  This size value rappresents the maximum limit of memory the OS
	  can assign to the Mali GPU.

config	STM_MALI_MEM_DEDICATED
	bool "Enable dedicated memory model"
	default n
	select BPA2
	---help---
	  Use this resource to configure dedicated areas of memory that are used
	  exclusively by the Mali GPU. You must not share this memory with
	  any other device or memory allocator.
	  The memory allocator privileges this than the shared.
	  Only when the dedicated memory will finish the allocator will use
	  the shared.

	  The driver will retreive base address and size from a BPA2 partition
	  called: mali-memory:base:size

	  bpa2parts=mali-memory:192M:0x40000000

	  If unsure don't enable this memory model.

endmenu
```
