## Documentation/devicetree/bindings/hwmon/stm-pwm.txt
```
===============================================================================
			stm pwm
===============================================================================

Required properties:
- compatible : "st,pwm".
- reg, reg-names, interrupts, interrupt-names	: Standard way to define device
			resources with names. look in
			Documentation/devicetree/bindings/resource-names.txt
- clk : Specify device clk on clk alias for this device

Required properties(Per Channel) PWM and CPT subnodes:
- padcfg	Standard way to pass pad config to the drivers.
- #address-cells: fixed to 1
- #size-cells: fixed to 0

- Child nodes "out" for each pwm output channel, which may contain following properties
    - reg: defines the channel number
    - st,initial-value: initial channel config required to be done during probe
    - st,retain-hw-value: channel config programmed by bootloader to be retained
    - st,locked: the channel is readonly for user

- Child node "capt" for each pwm capture channel, which may contain following property
    - reg: defines the channel number

Example:
	pwm0 {
		clk = "comms_clk";

		out {
			status = "okay";
			padcfg-names = "chan0", "chan1", "chan2", "chan3";
			padcfg-0 = <&padcfg_pwm0_chan0>;
			padcfg-1 = <&padcfg_pwm0_chan1>;
			padcfg-2 = <&padcfg_pwm0_chan2>;
			padcfg-3 = <&padcfg_pwm0_chan3>;

			#address-cells = <1>;
			#size-cells = <0>;
			out-channel@0 {
				reg = <0>;
				status = "disabled";
				st,initial-value = <0>;
				st,retain-hw-value;
				st,locked;
			};
			out-channel@1 {
				reg = <1>;
				status = "disabled";
				st,initial-value = <0>;
				st,retain-hw-value;
				st,locked;
			};
			out-channel@2 {
				reg = <2>;
				status = "disabled";
				st,initial-value = <0>;
				st,retain-hw-value;
				st,locked;
			};
			out-channel@3 {
				reg = <3>;
				status = "disabled";
				st,initial-value = <0>;
				st,retain-hw-value;
				st,locked;
			};
		};

		capt {
			status = "okay";
			padcfg-names = "chan0", "chan1", "chan2", "chan3";
			padcfg-0 = <&padcfg_capt0_chan0>;
			padcfg-1 = <&padcfg_capt0_chan1>;
			padcfg-2 = <&padcfg_capt0_chan2>;
			padcfg-3 = <&padcfg_capt0_chan3>;

			#address-cells = <1>;
			#size-cells = <0>;
			capt-channel@0 {
				reg = <0>;
				status = "disabled";
			};
			capt-channel@1 {
				reg = <1>;
				status = "disabled";
			};
			capt-channel@2 {
				reg = <2>;
				status = "disabled";
			};
			capt-channel@3 {
				reg = <3>;
				status = "disabled";
			};
		};
	};
```

## Documentation/devicetree/bindings/mmc/stm-sdhci.txt
```
* STMicroElectronics Secure Digital Host Controller

Required properties:
- compatible : Should be "st,sdhci"
- reg : Should contain SD/MMC registers location and length
- interrupts : Should contain SD/MMC interrupt

Optional properties:
- st,mmc-non-removable		Card is not removable i.e. eMMC
- st,mmc-core-init		To call the Arasan Core init and configure
				the host controller before accessing to its
				registers and configuring the driver to
				support one of the following SPEC:
					0: ARASAN_EMMC_4_5
					1: ARASAN_EMMC_4_3
					2: ARASAN_SD_3_0
					3: ARASAN_SD_2_0
- st,mmc-auto-tuning		To program HW like the DLL in Monaco and allow
				auto-tuning on super-speed selection.
- st,mmc-has-vsense		To switch among different voltages.

- st,no-hispd-bit		Do not have HISPD bit field in HI-SPEED SD card

Example:

sdhci@c8000200 {
	compatible = "st,sdhci";
	reg = <0xc8000200 0x200>;
	interrupts = <47>;
};
```

## Documentation/devicetree/bindings/sound/stm-audio-glue.txt
```
===============================================================================
			stm audio glue
===============================================================================

Required properties:
- compatible	: Should be "st,snd_audio_glue".
- device-config	: phandle to device config.

Typical usage example:

snd_audio_glue: snd-audio-glue {
	compatible	= "st,snd_audio_glue";
	status		= "disabled";
	device-config	= <&audio_glue_config>;

	audio_glue_config: audio-glue-config {
		device-seqs	= <&audio_glue_dev_seqs>;
		sysconfs {
			READER_INPUT	= <&sysconf 918 6 6>;
			EXT_DAC_OUTPUT	= <&sysconf 918 3 5>;
			EXT_DAC_CLOCK	= <&sysconf 918 1 2>;
			EXT_DAC_INVERT	= <&sysconf 918 0 0>;
		};
	};

	audio_glue_dev_seqs: audio-glue-dev-seqs {
		power-on-seq {
			step0 {
				READER_INPUT	= <0>;
				type		= "sysconf";
			};
			step1 {
				EXT_DAC_OUTPUT	= <1>;
				type		= "sysconf";
			};
			step2 {
				EXT_DAC_CLOCK	= <1>;
				type		= "sysconf";
			};
			step3 {
				EXT_DAC_INVERT	= <0>;
				type		= "sysconf";
			};
		};
		power-off-seq {
			step0 {
				READER_INPUT	= <0>;
				type		= "sysconf";
			};
			step1 {
				EXT_DAC_OUTPUT	= <0>;
				type		= "sysconf";
			};
			step2 {
				EXT_DAC_CLOCK	= <0>;
				type		= "sysconf";
			};
			step3 {
				EXT_DAC_INVERT	= <0>;
				type		= "sysconf";
			};
		};
	};
};
```

## Documentation/devicetree/bindings/sound/stm-conv-biphase.txt
```
===============================================================================
			stm bi-phase formatter converter
===============================================================================

Required properties:
- compatible	 : Should be "st,snd_conv_biphase".
- source-bus-id  : Player device is attached to.
- channel-to	 : Output channel (usually 1).
- channel-from	 : Input channel (usually 0).
- biphase-enable : Sysconf field to enable/disable bi-phase formatter
- biphase-idle	 : Sysconf field to set bi-phase formatter idle value
- biphase-idle-value : Bi-phase formatter idle value (usually 0)

Optional properties
- format		: Bitmask of the supported converter audio format
- oversampling		: Number of time oversampling (default is 256)

Typical usage example:

snd_conv_biphase: snd-conv-biphase {
	compatible	= "st,snd_conv_biphase";
	status		= "disabled";
	source-bus-id	= "snd_uni_player.4";
	channel-to	= <1>;
	channel-from	= <0>;
	biphase-enable	= <&sysconf 918 7 7>;
	biphase-idle	= <&sysconf 918 8 8>;
	biphase-idle-value = <0>;
};
```

## Documentation/devicetree/bindings/sound/stm-conv-dac-sc.txt
```
===============================================================================
			stm dac sysconf converter
===============================================================================

Required properties:
- compatible		: Should be "st,snd_conv_dac_sc".
- source-bus-id    	: Player device is attached to.
- channel-to	     	: Output channel (usually 1).
- channel-from	     	: Input channel (usually 0).
- not-reset	     	: Not reset sysconf (req).

Optional properties
- format		: Bitmask of the supported converter audio format
- oversampling		: Number of time oversampling (default is 256)

Only one of these should be provided:
- not-standby		: Not standby sysconf.
- standby		: Standby sysconf.

Only provide either softmute or mute-left and mute-right
- softmute		: Softmute sysconf.
- mute-left		: Mute left channel sysconf.
- mute-right		: Mute right channel sysconf.

- mode			: Mode sysconf.

Only on of these should be provided:
- analog-not-pwr-dwn	: Analog not power down sysconf.
- analog-pwr-dwn	: Analog power down sysconf.

- analog-not-pwr-dwn-bg	: Analog not power down band gap sysconf.
- analog-standby	: Analog standby sysconf.

Typical usage example:

snd_conv_dac_sc: snd-conv-dac-sc {
	compatible	= "st,snd_conv_dac_sc";
	status		= "disabled";
	source-bus-id	= "snd_uni_player.0";
	channel-to	= <1>;
	channel-from	= <0>;
	oversampling	= <128>;
	not-reset	= <&sysconf 917 0 0>;
	standby		= <&sysconf 917 1 1>;
	mute-left	= <&sysconf 917 2 2>;
	mute-right	= <&sysconf 917 3 3>;
};
```

## Documentation/devicetree/bindings/sound/stm-telss-glue.txt
```
===============================================================================
			stm telss glue
===============================================================================

Required properties:
- compatible		: Should be "st,snd_telss_glue"
- reg, reg-names	: Standard way to define device resource with names.
			Look in
			Documentation/devicetree/bindings/resource-names.txt
- version		: IP version
- mode			: Operational mode (DECT, LANTIQ, ZSI)
- loopback		: Loopback enabled (1) or disabled (0)


Typical usage example:

snd_telss_glue: snd-telss-glue {
	compatible	= "st,snd_telss_glue";
	status		= "disabled";
	reg		= <0xfeba8000 0x1000>;
	version		= <0>;
	mode		= "LANTIQ";
	loopback	= <0>;
};
```

## Documentation/devicetree/bindings/sound/stm-uni-player.txt
```
===============================================================================
			stm uniperipheral player
===============================================================================

Required properties:
- compatible		: Should be "st,snd_uni_player"
- reg, reg-names, interrupts, interrupt-names	: Standard way to define device
			resources with names. look in
			Documentation/devicetree/bindings/resource-names.txt
- padcfg-names		: Pad configuration name
- padcfg-0		: Pad configuration
- version		: IP version
- fdma-name		: Name of FDMA serving this player
- fdma-initiator	: Initiator type
- fdma-direct-conn	: DREQ is connected directly to FDMA (i.e. no DREQ mux)
- fdma-request-line	: Request line used by FDMA
- description		: Player description
- card-device		: ALSA card sub-device id
- mode			: Player mode (hdmi or pcm or spdif)
- iec958-lr-pol		: IEC958 device (hdmi/spdif) player LR polarity
			  (0=low, 1=high). Not used for players in pcm mode!
- iec958-i2s-mode	: IEC958 device (hdmi/spdif) player I2S mode.
			  (0=I2S, 1=Sony). Not used for players in pcm mode!
- channels		: Maximum number of output channels
- parking		: Enable parking mode
- standby		: Enable standby mode
- underflow		: Enable underflow recovery mode
- s16-swap-lr		: Swap left/right channels for S16 data


Typical usage example:

snd_uni_player0: snd-uni-player@0xfe285000 {
	compatible	= "st,snd_uni_player";
	status		= "disabled";
	reg		= <0xfe285000 0x150>;
	interrupts	= <0 67 0>;
	version		= <0>;
	fdma-name	= "stm-fdma.1";
	fdma-initiator	= <0>;
	fdma-request-line = <37>;
	description	= "Uni Player #0 (DAC)";
	card-device	= <0>;
	mode		= "PCM";
	channels	= <2>;
	parking		= <0>;
};
```

## Documentation/devicetree/bindings/sound/stm-uni-reader.txt
```
===============================================================================
			stm uniperipheral reader
===============================================================================

Required properties:
- compatible		: Should be "st,snd_uni_reader"
- reg, reg-names, interrupts, interrupt-names	: Standard way to define device
			resources with names. look in
			Documentation/devicetree/bindings/resource-names.txt
- padcfg-names		: Pad configuration name
- padcfg-0		: Pad configuration
- version		: IP version
- fdma-name		: Name of FDMA serving this reader
- fdma-initiator	: Initiator type
- fdma-direct-conn	: DREQ is connected directly to FDMA (i.e. no DREQ mux)
- fdma-request-line	: Request line used by FDMA
- description		: Reader description
- card-device		: ALSA card sub-device identifier
- channels		: Maximum number of output channels


Typical usage example:

snd_uni_reader0: snd-uni-reader@0xfe288000 {
	compatible	= "st,snd_uni_reader";
	status		= "disabled";
	reg		= <0xfe288000 0x150>;
	interrupts	= <0 72 0>;
	padcfg-names	= "default";
	padcfg-0	= <&padcfg_b2011_spdif_in>;
	version		= <0>;
	fdma-name	= "stm-fdma.0";
	fdma-initiator	= <0>;
	fdma-request-line = <42>;
	description	= "Uni Reader #0 (I2S)";
	card-device	= <5>;
	channels	= <8>;
};
```

## Documentation/devicetree/bindings/sound/stm-uni-tdm.txt
```
===============================================================================
			stm uniperipheral tdm
===============================================================================

Required properties:
- compatible		: Should be "st,snd_uni_tdm"
- reg, reg-names, interrupts, interrupt-names	: Standard way to define device
			resources with names. look in
			Documentation/devicetree/bindings/resource-names.txt
- padcfg-names		: Pad configuration name
- padcfg-0		: Pad configuration
- description		: TDM name
- version		: IP version
- card-device		: ALSA card sub-device id (set to 0xffffffff)
- fdma-name		: Name of FDMA serving this TDM
- fdma-channel		: Channel of FDMA serving this TDM
- fdma-initiator	: Initiator type
- fdma-direction	: Direction of transfer (DMA_MEM_TO_DEV/DMA_DEV_TO_MEM)
- fdma-direct-conn	: Request line is a direct connection
- fdma-request-line	: Request line used by FDMA
- rising-edge		: Data on rising edge (1) or falling edge (0)
- clk-rate		: Player only - clock rate in Hz
- frame-count		: Frames per audio period (must be a multiple of 8)
- max-periods		: Maximum audio periods
- hw-config		: TELSS device (e.g. Lantiq DuSlic) configuration

Hardware configuration:
- pclk-rate		: Player only - PCLK rate in Hz
- fs-rate		: Player only - FS REF rate in Hz
- fs-divider		: Timeslots per FS REF
- fs01-rate		: Player only - FS01 rate in Hz
- fs02-rate		: Player only - FS02 rate in Hz
- fs02-delay-clock	: Player only - FS02 delay from FS01
- fs02-delay-timeslot	: Player only - FS02 delay from FS01
- msbit-start		: Timslot start position
- timslot-info		: Timeslot information
- frame-size		: Frame size in 32-bit words
- handset-count		: Number of handsets
- handset-info		: Handset information

Handset information:
- fsync			: Handset fsync rate in Hz
- slot1			: Slot 1 ID
- slot2			: Slot 2 ID
- slot2-valid		: Slot 2 in use
- duplicate		: Duplicate bit
- data16		: Data size (0 = 8-bit, 1 = 16-bit)
- cnb			: Compressed Narrowband support
- lnb			: Linear Narrowband support
- cwb			: Compressed Wideband support
- lwb			: Linear Wideband support


Typical usage example:

snd_tdm_handset_info: snd-tdm-handset-info {
	handset0 {
		fsync	= <8000>;
		slot1	= <0>;
		slot2	= <2>;
		slot2-valid = <0>;
		duplicate = <0>;
		data16	= <0>;
		cnb	= <1>;
		lnb	= <1>;
		cwb	= <0>;
		lwb	= <1>;
	};
	handset1 {
		fsync	= <8000>;
		slot1	= <4>;
		slot2	= <6>;
		slot2-valid = <0>;
		duplicate = <0>;
		data16	= <0>;
		cnb	= <1>;
		lnb	= <1>;
		cwb	= <0>;
		lwb	= <1>;
	};
};

snd_tdm_lantiq_duslic_config: snd-uni-tdm-config {
	pclk-rate	= <1024000>;
	fs-rate		= <8000>;
	fs-divider	= <16>;
	fs01-rate	= <8000>;
	fs02-rate	= <8000>;
	fs02-delay-clock = <0>;
	fs02-delay-timeslot = <0>;
	msbit-start	= <0>;

	frame-size	= <4>;

	handset-count	= <2>;
	handset-info	= <&snd_tdm_lantiq_duslic_handset_info>;
};

snd_tdm_player0: snd-uni-tdm@0xfeba4000 {
	compatible	= "st,snd_uni_tdm";
	status		= "disabled";
	reg		= <0xfeba4000 0x150>;
	interrupts	= <0 219 0>;
	padcfg-names	= "default";
	padcfg-0	= <&padcfg_snd_tdm_player0>;

	description	= "Uni TDM Player #0";
	version		= <0>;
	card-device	= <0xffffffff>;

	fdma-name	= "stm-fdma.2";
	fdma-channel	= <1>;
	fdma-initiator	= <1>;
	fdma-direction	= "DMA_MEM_TO_DEV";
	fdma-direct-conn = <1>;
	fdma-request-line = <30>;

	clk-rate	= <49152000>;
	rising-edge	= <1>;
	hw-config	= <&snd_tdm_lantiq_duslic_config>;
	frame-count	= <80>;
	max-periods	= <10>;
};

snd_tdm_reader0: snd-uni-tdm@0xfeba5000 {
	compatible	= "st,snd_uni_tdm";
	status		= "disabled";
	reg		= <0xfeba5000 0x150>;
	interrupts	= <0 220 0>;
	padcfg-names	= "default";
	padcfg-0	= <&padcfg_snd_tdm_reader0>;

	description	= "Uni TDM Reader #0";
	version		= <0>;
	card-device	= <0xffffffff>;

	fdma-name	= "stm-fdma.2";
	fdma-channel	= <2>;
	fdma-initiator	= <1>;
	fdma-direction	= "DMA_DEV_TO_MEM";
	fdma-direct-conn = <1>;
	fdma-request-line = <29>;

	rising-edge	= <0>;
	hw-config	= <&snd_tdm_lantiq_duslic_config>;
	frame-count	= <80>;
	max-periods	= <10>;
};
```
